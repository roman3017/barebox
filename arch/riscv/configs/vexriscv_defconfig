## arch/riscv/configs/vexriscv_defconfig
```kconfig
CONFIG_MACH_VEXRISCV=y
CONFIG_BUILTIN_DTB=y
CONFIG_BUILTIN_DTB_NAME="vexriscv"
# CONFIG_GLOBALVAR is not set
CONFIG_TEXT_BASE=0x80f00000
CONFIG_MEMORY_LAYOUT_FIXED=y
CONFIG_STACK_BASE=0x82000000
CONFIG_MALLOC_BASE=0x82000000
CONFIG_MALLOC_TLSF=y
CONFIG_PANIC_HANG=y
CONFIG_BOOTM_SHOW_TYPE=y
CONFIG_BOOTM_VERBOSE=y
CONFIG_BOOTM_INITRD=y
CONFIG_BOOTM_OFTREE=y
CONFIG_BOOTM_OFTREE_UIMAGE=y
CONFIG_CONSOLE_SIMPLE=y
# CONFIG_ENV_HANDLING is not set
CONFIG_POLLER=y
CONFIG_DEFAULT_LOGLEVEL=8
CONFIG_DEBUG_LL=y
CONFIG_DEBUG_INITCALLS=y
CONFIG_CMD_DMESG=y
CONFIG_LONGHELP=y
CONFIG_CMD_MEMINFO=y
CONFIG_CMD_BOOT=y
CONFIG_CMD_GO=y
# CONFIG_CMD_MOUNT is not set
# CONFIG_CMD_UMOUNT is not set
# CONFIG_CMD_CAT is not set
# CONFIG_CMD_CD is not set
# CONFIG_CMD_CP is not set
# CONFIG_CMD_LS is not set
# CONFIG_CMD_MKDIR is not set
# CONFIG_CMD_PWD is not set
# CONFIG_CMD_RM is not set
# CONFIG_CMD_RMDIR is not set
# CONFIG_CMD_FALSE is not set
# CONFIG_CMD_TEST is not set
# CONFIG_CMD_TRUE is not set
CONFIG_CMD_DHCP=y
CONFIG_CMD_PING=y
CONFIG_CMD_TIME=y
CONFIG_NET=y
CONFIG_OFDEVICE=y
# CONFIG_SPI is not set
# CONFIG_PINCTRL is not set
# CONFIG_FS_RAMFS is not set
# CONFIG_FS_DEVFS is not set
```

## arch/riscv/configs/vexriscv_rich_defconfig
```kconfig
CONFIG_MACH_VEXRISCV=y
CONFIG_BUILTIN_DTB=y
CONFIG_BUILTIN_DTB_NAME="vexriscv"
# CONFIG_GLOBALVAR is not set
CONFIG_TEXT_BASE=0x80f00000
CONFIG_MEMORY_LAYOUT_FIXED=y
CONFIG_STACK_BASE=0x81000000
CONFIG_STACK_SIZE=0x10000
CONFIG_MALLOC_BASE=0x81000000
CONFIG_EXPERIMENTAL=y
CONFIG_PANIC_HANG=y
# CONFIG_BOOTM is not set
CONFIG_CONSOLE_RATP=y
# CONFIG_ENV_HANDLING is not set
CONFIG_DEFAULT_ENVIRONMENT=y
CONFIG_DEFAULT_ENVIRONMENT_PATH="/env"
CONFIG_DEFAULT_LOGLEVEL=8
CONFIG_DEBUG_LL=y
CONFIG_DEBUG_INITCALLS=y
CONFIG_UBSAN=y
CONFIG_CMD_DMESG=y
CONFIG_LONGHELP=y
CONFIG_CMD_IOMEM=y
CONFIG_CMD_IMD=y
CONFIG_CMD_MEMINFO=y
CONFIG_CMD_POLLER=y
CONFIG_CMD_GO=y
CONFIG_CMD_LOADB=y
CONFIG_CMD_LOADS=y
CONFIG_CMD_LOADY=y
CONFIG_CMD_RESET=y
CONFIG_CMD_SAVES=y
CONFIG_CMD_PARTITION=y
CONFIG_CMD_AUTOMOUNT=y
CONFIG_CMD_EXPORT=y
CONFIG_CMD_DEFAULTENV=y
CONFIG_CMD_PRINTENV=y
CONFIG_CMD_MAGICVAR=y
CONFIG_CMD_MAGICVAR_HELP=y
CONFIG_CMD_BASENAME=y
CONFIG_CMD_CMP=y
CONFIG_CMD_DIRNAME=y
CONFIG_CMD_FILETYPE=y
CONFIG_CMD_LN=y
CONFIG_CMD_MD5SUM=y
CONFIG_CMD_READLINK=y
CONFIG_CMD_UNCOMPRESS=y
# CONFIG_CMD_FALSE is not set
# CONFIG_CMD_TEST is not set
# CONFIG_CMD_TRUE is not set
CONFIG_CMD_DHCP=y
CONFIG_CMD_HOST=y
CONFIG_NET_CMD_IFUP=y
CONFIG_CMD_PING=y
# CONFIG_CMD_CLEAR is not set
# CONFIG_CMD_ECHO is not set
CONFIG_CMD_CLK=y
CONFIG_CMD_DETECT=y
CONFIG_CMD_FLASH=y
CONFIG_CMD_OF_DUMP=y
CONFIG_CMD_TIME=y
CONFIG_NET=y
CONFIG_OFDEVICE=y
CONFIG_SERIAL_DEV_BUS=y
# CONFIG_SPI is not set
CONFIG_SRAM=y
# CONFIG_PINCTRL is not set
CONFIG_FS_RATP=y
```

## arch/riscv/mach-vexriscv/Kconfig
```kconfig
if MACH_VEXRISCV

choice
	prompt "Board type"

config BOARD_VEXRISCV_GENERIC
	bool "vexriscv generic board"

endchoice

endif
```
